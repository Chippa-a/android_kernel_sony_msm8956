/* arch/arm64/boot/dts/qcom/msm8956-loire-common.dtsi
 *
 * This program is free software; you can redistribute it and/or modify
 * it under the terms of the GNU General Public License version 2 and
 * only version 2 as published by the Free Software Foundation.
 *
 * This program is distributed in the hope that it will be useful,
 * but WITHOUT ANY WARRANTY; without even the implied warranty of
 * MERCHANTABILITY or FITNESS FOR A PARTICULAR PURPOSE.  See the
 * GNU General Public License for more details.
 */
/*
 * Copyright (C) 2014 Sony Mobile Communications Inc.
 *
 * This program is free software; you can redistribute it and/or modify
 * it under the terms of the GNU General Public License version 2, as
 * published by the Free Software Foundation.
 */

/ {
	reserved-memory {
		ramoops: ramoops@57f00000 {
			compatible = "removed-dma-pool", "ramoops";
			no-map;
			reg = <0 0x57f00000 0 0x00100000>;
			record-size = <0x20000>;
			console-size = <0x60000>;
			ftrace-size = <0x20000>;
			pmsg-size = <0x0>;
			ecc-size = <0x0>;
		};

		tz_app_mem: tz_app_mem@8dd00000 {
			compatible = "removed-dma-pool";
			no-map;
			reg = <0x0 0x8dd00000 0x0 0x1400000>;
		};
	};

};

&soc {
	pinctrl@1000000 {
		disabled-pins = <0 1 2 3>;
	};

	fpc1145: fpc1145@0 {
		reg = <0>;
		status = "ok";
		compatible = "fpc,fpc1020", "fpc1145";
		interrupt-parent = <&msm_gpio>;
		interrupts = <106 0x0>;
		fpc,gpio_rst    = <&msm_gpio 69 0x0>;
		fpc,gpio_irq    = <&msm_gpio 106 0x0>;
		fpc,gpio_ldo    = <&msm_gpio 112 0>;
		vcc_spi-supply  = <&pm8950_s4>;

		pinctrl-names = "fpc1145_reset_reset",
				"fpc1145_reset_active",
				"fpc1145_irq_active",
				"fpc1145_ldo_enable",
				"fpc1145_ldo_disable";

		pinctrl-0 = <&msm_gpio_69_def>;
		pinctrl-1 = <&msm_gpio_69_output_high>;
		pinctrl-2 = <&msm_gpio_106_def>;
		pinctrl-3 = <&msm_gpio_112_enable>;
		pinctrl-4 = <&msm_gpio_112_def>;
	};

	/* SPI : BLSP1 */
	spi@0x78B5000 { /* BLSP1 QUP0 */
		status = "disabled";
	};

	/* HS UART : BLSP2 */
	blsp1_hsuart2: hsuart@78b0000 { /* BLSP1 UART2 */
		compatible = "qcom,msm-hsuart-v14";
		reg = <0x78b0000 0x200>,
			<0x7884000 0x1f000>;
		reg-names = "core_mem", "bam_mem";
		interrupt-names = "core_irq", "bam_irq";
		#address-cells = <0>;
		interrupt-parent = <&blsp1_hsuart2>;
		interrupts = <0 1>;
		#interrupt-cells = <1>;
		interrupt-map-mask = <0xffffffff>;
		interrupt-map = <0 &intc 0 108 0
				1 &intc 0 238 0>;

		qcom,tx-gpio = <&msm_gpio 4 0>;
		qcom,rx-gpio = <&msm_gpio 5 0>;
		qcom,cts-gpio = <&msm_gpio 6 0>;
		qcom,rfr-gpio = <&msm_gpio 7 0>;
		/delete-property/ qcom,inject-rx-on-wakeup;
		/delete-property/ qcom,rx-char-to-inject;
		qcom,master-id = <86>;
		clock-names = "core_clk", "iface_clk";
		clocks = <&clock_gcc clk_gcc_blsp1_uart2_apps_clk>,
				<&clock_gcc clk_gcc_blsp1_ahb_clk>;
		pinctrl-names = "default", "sleep";
		pinctrl-0 = <&msm_gpio_4_act &msm_gpio_5_def &msm_gpio_6_def &msm_gpio_7_act>;
		pinctrl-1 = <&msm_gpio_4_sus &msm_gpio_5_def &msm_gpio_6_def &msm_gpio_7_sus>;
		qcom,bam-tx-ep-pipe-index = <2>;
		qcom,bam-rx-ep-pipe-index = <3>;
		qcom,msm-bus,name = "blsp1_hsuart2";
		qcom,msm-bus,num-cases = <2>;
		qcom,msm-bus,num-paths = <1>;
		qcom,msm-bus,vectors-KBps =
					<86 512 0 0>,
					<86 512 500 800>;
		status = "okay";
	};

	/delete-node/ qcom,iris-fm;

	bluesleep {
		compatible = "bcm,bluesleep";
		bt_host_wake = <&msm_gpio 17 0x00>; /* BT_HOST_WAKE */
		bt_ext_wake = <&msm_gpio 18 0x00>; /* BT_DEV_WAKE */
		interrupt-parent = <&msm_gpio>;
		interrupts = <17 0>;
		interrupt-names = "host_wake";
		pinctrl-names = "wake_irq_active", "wake_irq_suspend";
		pinctrl-0 = <&msm_gpio_17_act &msm_gpio_18_def>;
		pinctrl-1 = <&msm_gpio_17_sus &msm_gpio_18_def>;
	};

	bcm43xx {
		compatible = "bcm,bcm43xx";
		bcm,reg-on-gpio = <&msm_gpio 19 0x00>; /* BT_REG_ON */
		pinctrl-names = "default", "sleep";
		pinctrl-0 = <&msm_gpio_19_def>;
		pinctrl-1 = <&msm_gpio_19_def>;
	};

	/* SPI : BLSP3 */
	/* Kernel default setting will be overridden by ADSP SW. */

	/* SPI : BLSP4 */
	/* I2C : BLSP4 */
	i2c@78b8000 { /* BLSP1 QUP3 */
		qcom,clk-freq-out = <355000>;
		pinctrl-0 = <&msm_gpio_14_def &msm_gpio_15_def>;
		pinctrl-1 = <&msm_gpio_14_sus &msm_gpio_15_sus>;
		status = "okay";

		/delete-node/ synaptics@20;

		synaptics_clearpad@2c {
			compatible = "synaptics,clearpad";
			reg = <0x2c>;
			interrupt-parent = <&msm_gpio>;
			interrupts = <65 0x2>;
			synaptics,irq_gpio = <&msm_gpio 65 0x00>;
			post_probe_start = <0>;
			synaptics,firmware_name = "touch_module_id_0x%02x.img";
			flash_on_post_probe = <1>;
			flip_config = <0>;
			watchdog_enabled = <1>;
			watchdog_delay_ms = <3000>;
			charger_supported = <0>;
			pen_supported = <0>;
			glove_supported = <1>;
			cover_supported = <1>;
			touch_pressure_enabled = <1>;
			touch_size_enabled = <0>;
			touch_orientation_enabled = <0>;
			preset_x_max = <1079>;
			preset_y_max = <1919>;
			preset_n_fingers = <10>;
			wakeup_gesture_supported = <1>;
			wakeup_gesture_lpm_disabled = <1>;
			wakeup_gesture_timeout = <0>;
			wakeup_gesture {
				double_tap {
					gesture_code = <0x0003>;
					event_00 {
						type = <2>; /* LOG */
						message = "=== DOUBLE TAP ===";
					};
					event_01 {
						type = <1>; /* KEY */
						code = <531>; /* TOUCHPAD_ON */
						down = <1>;
					};
					event_02 {
						type = <1>; /* KEY */
						code = <531>; /* TOUCHPAD_ON */
						down = <0>;
					};
					event_03 {
						type = <99>; /* END */
					};
				};
			};
			/* chip settings */
			clearpad_default {
				flash_default_timeout_ms = <20000>;
				calibrate_on_fwflash = <0>;
				calibration_supported = <0>;
				hwreset_delay_for_powerup_ms = <220>;
				interrupt_default_wait_ms = <1000>;
			};
			S3330 {
				flash_default_timeout_ms = <20000>;
				calibrate_on_fwflash = <0>;
				calibration_supported = <0>;
				hwreset_delay_for_powerup_ms = <220>;
				interrupt_default_wait_ms = <1000>;
			};
			S332U {
				flash_default_timeout_ms = <20000>;
				calibrate_on_fwflash = <1>;
				calibration_supported = <1>;
				hwreset_delay_for_powerup_ms = <220>;
				interrupt_default_wait_ms = <1000>;
			};
		};
	};

	/* I2C : BLSP5 */
	/* Kernel default setting will be overridden by ADSP SW. */

	/* UART: BLSP6 */
	serial@7af0000 { /* BLSP2 UART2 */
		compatible = "qcom,msm-uartdm-v1.4", "qcom,msm-uartdm";
		reg = <0x7af0000 0x200>;
		interrupts = <0 307 0>;
		clocks = <&clock_gcc clk_gcc_blsp2_uart2_apps_clk>,
				<&clock_gcc clk_gcc_blsp2_ahb_clk>;
		clock-names = "core", "iface";
		pinctrl-names = "default";
		pinctrl-0 = <&msm_gpio_20_def &msm_gpio_21_def>;
		status = "okay";
	};

	/* I2C : BLSP6 */
	i2c@7af6000 { /* BLSP2 QUP1 */
		qcom,clk-freq-out = <355000>;
		pinctrl-0 = <&msm_gpio_22_def &msm_gpio_23_def>;
		pinctrl-1 = <&msm_gpio_22_def &msm_gpio_23_def>;
		status = "okay";
		as3668@42 {
			compatible = "as3668";
			reg = <0x42>;
			label = "rgb";
			status = "okay";
			somc,led_num = <3>;
			somc,pattern_start_source = <0>;
			somc,pwm_source = <0>;
			somc,pattern_pwm_dim_speed_down_ms = <0>;
			somc,pattern_pwm_dim_speed_up_ms = <0>;
			somc,pattern_source_mask = <7>;
			somc,pattern_multiple_pulse = <1>;
			somc,pattern_tp_led = <0>;
			somc,pattern_fade_out = <0>;
			somc,color_variation_max_num = <1>;
			somc,max_current_uA = <0 12000 5000 4000 4000 8000 8000>;
			somc,rgb_blue {
				label = "rgb";
				linux,name = "as3668:blue";
				somc,pattern_frame_mask = <0>;
				somc,pattern_frame_delay = <0>;
				linux,default-trigger = "none";
			};
			somc,rgb_red {
				label = "rgb";
				linux,name = "as3668:red";
				somc,pattern_frame_mask = <0>;
				somc,pattern_frame_delay = <0>;
				linux,default-trigger = "none";
			};
			somc,rgb_green {
				label = "rgb";
				linux,name = "as3668:green";
				somc,pattern_frame_mask = <0>;
				somc,pattern_frame_delay = <0>;
				linux,default-trigger = "none";
			};
		};
	};

	somc_pinctrl: somc_pinctrl {
		compatible = "somc-pinctrl";
		pinctrl-names = "platform_common_default",
				"product_common_default",
				"variant_default";
		pinctrl-0 = <&msm_gpio_4_sus &msm_gpio_5_def
					&msm_gpio_6_def &msm_gpio_7_sus &msm_gpio_8_def
					&msm_gpio_9_def &msm_gpio_10_def &msm_gpio_11_def
					&msm_gpio_12_def &msm_gpio_13_def &msm_gpio_14_def
					&msm_gpio_15_def &msm_gpio_16_def &msm_gpio_17_sus
					&msm_gpio_18_def &msm_gpio_19_def &msm_gpio_20_def
					&msm_gpio_21_def &msm_gpio_22_def &msm_gpio_23_def
					&msm_gpio_24_def &msm_gpio_25_def &msm_gpio_26_def
					&msm_gpio_27_def &msm_gpio_28_def &msm_gpio_29_def
					&msm_gpio_30_def &msm_gpio_31_def &msm_gpio_32_def
					&msm_gpio_33_def &msm_gpio_34_def &msm_gpio_35_def
					&msm_gpio_36_def &msm_gpio_37_def &msm_gpio_38_def
					&msm_gpio_39_def &msm_gpio_40_def &msm_gpio_41_def
					&msm_gpio_42_def &msm_gpio_43_def &msm_gpio_44_def
					&msm_gpio_45_def &msm_gpio_46_def &msm_gpio_47_def
					&msm_gpio_48_def &msm_gpio_49_def &msm_gpio_50_def
					&msm_gpio_51_def &msm_gpio_52_def &msm_gpio_56_def
					&msm_gpio_60_def &msm_gpio_62_def &msm_gpio_63_def
					&msm_gpio_64_def &msm_gpio_65_def &msm_gpio_66_def
					&msm_gpio_67_def &msm_gpio_68_def &msm_gpio_69_def
					&msm_gpio_74_def &msm_gpio_75_def &msm_gpio_92_def
					&msm_gpio_94_def &msm_gpio_95_def &msm_gpio_96_def
					&msm_gpio_97_def &msm_gpio_100_def &msm_gpio_101_def
					&msm_gpio_103_def &msm_gpio_104_def &msm_gpio_106_def
					&msm_gpio_107_def &msm_gpio_108_def &msm_gpio_109_def
					&msm_gpio_110_def &msm_gpio_111_def &msm_gpio_112_def
					&msm_gpio_116_def &msm_gpio_122_def &msm_gpio_124_def
					&msm_gpio_126_def &msm_gpio_127_def &msm_gpio_128_def
					&msm_gpio_129_def &msm_gpio_130_def &msm_gpio_131_def
					&msm_gpio_132_def &msm_gpio_136_def &msm_gpio_137_def
					&msm_gpio_141_def &msm_gpio_143_def &msm_gpio_144_def>;

		/* If product common default setting is needed,
		   fill pinctrl-1 value in <product>_common.dtsi */
		pinctrl-1 = <>;

		/* If variant specific default setting is needed,
		   fill pinctrl-2 value in <variant>.dtsi */
		pinctrl-2 = <>;

		/* If variant specific default setting is needed,
		   fill pinctrl-3 value in <variant>.dtsi */
		pinctrl-3 = <>;
	};

	somc_pinctrl_pmic: somc_pinctrl_pmic {
		compatible = "somc-pinctrl-pmic";
		pinctrl-names = "platform_common_default",
				"product_common_default",
				"variant_default";

		pinctrl-0 = <&pm8950_gpio_2 &pm8950_gpio_5 &pm8950_gpio_6
			    &pm8950_gpio_7 &pm8950_gpio_8
			    &pmi8950_gpio_1 &pmi8950_gpio_2
			    &pmi8950_mpp_1 &pmi8950_mpp_3 &pmi8950_mpp_4
			    &pm8004_mpp_3 &pm8004_mpp_4>;

		/* If product common PMIC default setting is needed,
		fill pinctrl-1 value in <product>_common.dtsi */
		pinctrl-1 = <>;

		/* If variant specific PMIC default setting is needed,
		fill pinctrl-2 value in <variant>.dtsi */
		pinctrl-2 = <>;

		/* If variant specific default setting is needed,
		fill pinctrl-3 value in <variant>.dtsi */
		pinctrl-3 = <>;
	};

	mdss_dsi: qcom,mdss_dsi@0 {
		vdda-supply = <&pm8950_l23>;

		mdss_dsi0: qcom,mdss_dsi_ctrl0@1a94000 {
			vdd-supply = <&pm8950_l23>;
			vddio-supply = <&pm8950_l6>;
			touch-avdd-supply = <&pm8950_l22>;
		};

		mdss_dsi1: qcom,mdss_dsi_ctrl1@1a96000 {
			vdd-supply = <&pm8950_l23>;
			vddio-supply = <&pm8950_l6>;
			touch-avdd-supply = <&pm8950_l22>;
		};
	};

	dsi_panel_pwr_supply_hybrid_incell: dsi_panel_pwr_supply_hybrid_incell {
		#address-cells = <1>;
		#size-cells = <0>;

		qcom,panel-supply-entry@0 {
			reg = <0>;
			qcom,supply-name = "vdd";
			qcom,supply-min-voltage = <1200000>;
			qcom,supply-max-voltage = <1200000>;
			qcom,supply-enable-load = <100000>;
			qcom,supply-disable-load = <100>;
		};

		qcom,panel-supply-entry@1 {
			reg = <1>;
			qcom,supply-name = "vddio";
			qcom,supply-min-voltage = <1800000>;
			qcom,supply-max-voltage = <1800000>;
			qcom,supply-enable-load = <100000>;
			qcom,supply-disable-load = <100>;
		};

		qcom,panel-supply-entry@2 {
			reg = <2>;
			qcom,supply-name = "lab";
			qcom,supply-min-voltage = <4600000>;
			qcom,supply-max-voltage = <6000000>;
			qcom,supply-enable-load = <100000>;
			qcom,supply-disable-load = <100>;
		};

		qcom,panel-supply-entry@3 {
			reg = <3>;
			qcom,supply-name = "ibb";
			qcom,supply-min-voltage = <4600000>;
			qcom,supply-max-voltage = <6000000>;
			qcom,supply-enable-load = <100000>;
			qcom,supply-disable-load = <100>;
		};

		qcom,panel-supply-entry@4 {
			reg = <4>;
			qcom,supply-name = "touch-avdd";
			qcom,supply-min-voltage = <3000000>;
			qcom,supply-max-voltage = <3000000>;
			qcom,supply-enable-load = <100000>;
			qcom,supply-disable-load = <100>;
		};
	};

	dsi_panel_pwr_supply_full_incell: dsi_panel_pwr_supply_full_incell {
		#address-cells = <1>;
		#size-cells = <0>;

		qcom,panel-supply-entry@0 {
			reg = <0>;
			qcom,supply-name = "vdd";
			qcom,supply-min-voltage = <1200000>;
			qcom,supply-max-voltage = <1200000>;
			qcom,supply-enable-load = <100000>;
			qcom,supply-disable-load = <100>;
		};

		qcom,panel-supply-entry@1 {
			reg = <1>;
			qcom,supply-name = "vddio";
			qcom,supply-min-voltage = <1800000>;
			qcom,supply-max-voltage = <1800000>;
			qcom,supply-enable-load = <100000>;
			qcom,supply-disable-load = <100>;
		};

		qcom,panel-supply-entry@2 {
			reg = <2>;
			qcom,supply-name = "lab";
			qcom,supply-min-voltage = <4600000>;
			qcom,supply-max-voltage = <6000000>;
			qcom,supply-enable-load = <100000>;
			qcom,supply-disable-load = <100>;
		};

		qcom,panel-supply-entry@3 {
			reg = <3>;
			qcom,supply-name = "ibb";
			qcom,supply-min-voltage = <4600000>;
			qcom,supply-max-voltage = <6000000>;
			qcom,supply-enable-load = <100000>;
			qcom,supply-disable-load = <100>;
		};

		/delete-node/ qcom,panel-supply-entry@4;
	};

	cdc_quat_mi2s_gpios: msm_cdc_pinctrl_quat {
		compatible = "qcom,msm-cdc-pinctrl";
		pinctrl-names = "aud_active", "aud_sleep";
		pinctrl-0 = <&sec_tlmm_lines_act &sec_tlmm_2_lines_act>;
		pinctrl-1 = <&sec_tlmm_lines_sus &sec_tlmm_2_lines_sus>;
	};

	ldo_vibrator {
		compatible = "ldo-vibrator";
		gpios = <&pmi8950_gpios 2 1>;
	};

	qcom,wdt@b017000 {
		qcom,bark-time = <12000>;
	};

	gpio_keys {
		compatible = "gpio-keys";
		label = "gpio-keys";

		vol_up {
			label = "volume_up";
			gpios = <&msm_gpio 130 0x1>;
			linux,input-type = <1>;
			linux,code = <115>;
			gpio-key,wakeup;
			debounce-interval = <15>;
		};

		vol_dn {
			label = "volume_down";
			gpios = <&msm_gpio 113 0x1>;
			linux,input-type = <1>;
			linux,code = <114>;
			gpio-key,wakeup;
			debounce-interval = <15>;
		};

		camera_focus {
			label = "camera_focus";
			gpios = <&msm_gpio 114 0x1>;
			linux,input-type = <1>;
			linux,code = <0x210>;
			gpio-key,wakeup;
			debounce-interval = <15>;
		};

		camera_snapshot {
			label = "camera_snapshot";
			gpios = <&msm_gpio 115 0x1>;
			linux,input-type = <1>;
			linux,code = <0x2fe>;
			gpio-key,wakeup;
			debounce-interval = <15>;
		};
	};

	bu520x1nvx {
		compatible = "rohm,bu520x1nvx";

		acc_cover {
			label = "lid";
			gpios = <&msm_gpio 68 0x1>;
			lid-pin = <1>;
			open-debounce-interval = <120>;
			close-debounce-interval = <300>;
		};
	};

	sim_detect {
		compatible = "sim-detect";

		sim1_det {
			label = "sim-detection";
			gpios = <&msm_gpio 60 0x0>;
			debounce-interval = <10>;
		};
	};

	qcom,msm-imem@8600000 {
		debug_base@18 {
			compatible = "qcom,msm-imem-debug_base";
			reg = <0x18 4>;
		};
	};

	/delete-node/ qcom,wcnss-wlan@0a000000;
	/delete-node/ qcom,pronto@a21b000;

	bcmdhd_wlan {
		compatible = "android,bcmdhd_wlan";
		gpios = <&msm_gpio 48 0x00>, /* WL_REG_ON */
			<&msm_gpio 45 0x00>; /* WL_HOST_WAKE */
		pinctrl-names = "default", "sleep";
		pinctrl-0 = <&msm_gpio_48_def &msm_gpio_45_def>;
		pinctrl-1 = <&msm_gpio_48_def &msm_gpio_45_def>;

		qcom,msm-bus,name = "msm-bcmdhd";
		qcom,msm-bus,num-cases = <3>;
		qcom,msm-bus,num-paths = <1>;
		qcom,msm-bus,vectors-KBps =
			<45 512 0 0>, /* None vote */
			<45 512 500 800>, /* Low vote */
			<45 512 500 5448000>; /* High Vote */
	};

	usb_otg: usb@78db000 {
		qcom,usb-switch-sel-gpio = <&pmi8950_gpios 1 0>;
		qcom,usbin-vadc = <&pmi8950_vadc>;
	};

	qcom,cpp@1b04000 {
		qcom,min-clock-rate = <200000000>;
	};

	/delete-node/ qseecom@85b00000;
	qcom_seecom: qseecom@8dd00000 {
		compatible = "qcom,qseecom";
		reg = <0x8dd00000 0x1400000>;
		reg-names = "secapp-region";
		qcom,hlos-num-ce-hw-instances = <1>;
		qcom,hlos-ce-hw-instance = <0>;
		qcom,qsee-ce-hw-instance = <0>;
		qcom,msm-bus,name = "qseecom-noc";
		qcom,disk-encrypt-pipe-pair = <2>;
		qcom,support-fde;
		qcom,appsbl-qseecom-support;
		qcom,msm-bus,num-cases = <4>;
		qcom,msm-bus,num-paths = <1>;
		qcom,support-bus-scaling;
		qcom,msm-bus,vectors-KBps =
			<55 512 0 0>,
			<55 512 0 0>,
			<55 512 120000 1200000>,
			<55 512 393600 3936000>;
		clocks = <&clock_gcc clk_crypto_clk_src>,
			 <&clock_gcc clk_gcc_crypto_clk>,
			 <&clock_gcc clk_gcc_crypto_ahb_clk>,
			 <&clock_gcc clk_gcc_crypto_axi_clk>;
		clock-names = "core_clk_src", "core_clk",
				"iface_clk", "bus_clk";
		qcom,ce-opp-freq = <100000000>;
	};

	qcom,mpm2-sleep-counter@4a3000 {
		compatible = "qcom,mpm2-sleep-counter";
		reg = <0x4a3000 0x1000>;
		clock-frequency = <32768>;
	};
};

&pm8950_gpios {
	/* GPIO_1: CDC_PM_MCLK */
	/* Follow QCT */

	/* GPIO_2: WL_SLEEP_CLKK */
	pm8950_gpio_2: pm8950_gpio_2 {
		pins = "gpio2";
		function = "func1";
		output-high;
		bias-disable;
		power-source = <0>;
		qcom,drive-strength = <1>;
	};

	/* GPIO_3: BATT_UICC_ALARM */
	/* Follow QCT */

	/* GPIO_4: BOOST_BYP_MODE_CTL */
	/* Follow QCT */

	/* GPIO_5: NFC_CLK_REQ */
	pm8950_gpio_5: pm8950_gpio_5 {
		pins = "gpio5";
		function = "normal";
		input-enable;
		bias-pull-down;
		power-source = <3>;
		qcom,drive-strength = <1>;
	};

	/* GPIO_6: (USB_SHELL_SEL) */
	pm8950_gpio_6: pm8950_gpio_6 {
		pins = "gpio6";
		function = "normal";
		bias-high-impedance; /* DISABLE GPIO6 */
	};

	/* GPIO_7: WCD_ELDO_EN */
	/* Follow QCT */

	/* GPIO_8: USB_ID_DET_N */
	pm8950_gpio_8: pm8950_gpio_8 {
		pins = "gpio8";
		function = "normal";
		output-low;
		power-source = <0>;
		qcom,drive-strength = <1>;
	};
};

&pmi8950_gpios {
	/* GPIO_1: USB_SWITCH_SEL */
	pmi8950_gpio_1: pmi8950_gpio_1 {
		pins = "gpio1";
		function = "normal";
		output-low;
		drive-push-pull;
		qcom,drive-strength = <1>;
		power-source = <0>;
	};

	/* GPIO_2: VIB_LDO_EN */
	pmi8950_gpio_2: pmi8950_gpio_2 {
		pins = "gpio2";
		function = "normal";
		output-low;
		drive-push-pull;
		qcom,drive-strength = <1>;
		power-source = <0>;
	};
};

&pmi8950_mpps {
	/* MPP_1: PMI8952_ADC_IN */
	pmi8950_mpp_1: pmi8950_mpp_1 {
		pins = "mpp1";
		function = "analog";
		input-enable;
		qcom,amux-route = <0>;
	};

	/* MPP_2: BOOST_BYP_VSEL */
	/* Follow QTI */

	/* MPP_3: EXT_FET_WLED_PWR_EN */
	pmi8950_mpp_3: pmi8950_mpp_3 {
		pins = "mpp3";
		bias-high-impedance; /* DISABLE MPP3 */
	};

	/* MPP_4: FLASH_STROBE_NOW */
	pmi8950_mpp_4: pmi8950_mpp_4 {
		pins = "mpp4";
		function = "digital";
		input-enable;
		power-source = <2>;
	};
};

&pmi8950_flash1 {
	status = "disabled";
};

&pmi8950_torch1 {
	status = "disabled";
};

&pm8004_mpps {
	/* MPP_1: pull-down to GND (PM8004_PON_SYNC) */
	/* Follow QTI */

	/* MPP_2: NC */
	pm8004_mpp_2: pm8004_mpp_2 {
		pins = "mpp2";
	};

	/* MPP_3: DEBUG_GPIO_0 */
	pm8004_mpp_3: pm8004_mpp_3 {
		pins = "mpp3";
		function = "digital";
		output-low;
		power-source = <3>;
	};

	/* MPP_4: DEBUG_GPIO_1 */
	pm8004_mpp_4: pm8004_mpp_4 {
		pins = "mpp4";
		function = "digital";
		output-low;
		power-source = <3>;
	};
};

/{
	loire_batterydata: qcom,battery-data {
		qcom,batt-id-range-pct = <17>;
		/delete-node/ qcom,itech-3000mah-4200mv;
		/delete-node/ qcom,itech-3000mah;
	};
};

&qpnp_fg {
	qcom,battery-data = <&loire_batterydata>;
	qcom,hot-bat-decidegc = <550>;
	qcom,warm-bat-decidegc = <450>;
	qcom,cool-bat-decidegc = <100>;
	qcom,cold-bat-decidegc = <50>;
	qcom,cl-max-increment-deciperc = <0>;
	qcom,cl-max-decrement-deciperc = <20>;
	qcom,cl-max-start-capacity = <40>;
	qcom,hold-soc-while-full;
	qcom,fg-chg-iterm-ma = <140>;
	qcom,fg-iterm-ma = <140>;
	qcom,thermal-coefficients = [EC 85 75 4A FC 35];
	qcom,ext-sense-type;
	qcom,fg-cutoff-voltage-mv = <3200>;
	qcom,vbat-estimate-diff-mv = <200>;
	qcom,cl-vbat-est-thr-uv = <300000>;
	qcom,fg-cc-cv-threshold-mv = <4290>;
	somc,resume-soc-raw-full-normal = <0xF3>;
	somc,resume-soc-raw-full-aging = <0xE3>;
	somc,resume-soc-raw-not-full-normal = <0xFD>;
	somc,resume-soc-raw-not-full-aging = <0xEF>;
};

&qpnp_smbcharger {
	/delete-property/ qcom,parallel-usb-min-current-ma;
	/delete-property/ qcom,parallel-usb-9v-min-current-ma;
	qcom,charge-unknown-battery;
	qcom,usb_dp-vadc = <&pmi8950_vadc>;
	qcom,usb_dm-vadc = <&pmi8950_vadc>;
	qcom,usbin-vadc = <&pmi8950_vadc>;
	qcom,float-voltage-mv = <4300>;
	qcom,precharging-timeout-mins = <24>;
	qcom,charging-timeout-mins = <768>;
	qcom,bmd-pin-src = "bpd_none";
	qcom,force-aicl-rerun;
	id_poll_enable;
	id_poll_up_interval = <2000>;
	id_poll_up_period = <50000>;
	id_poll_pd_gpio = <&pm8950_gpios 8 0>;
	id_poll_pd_invert = <1>;
};

&pm8950_vadc {
	chan@13 { /* case_therm */
		qcom,scale-function = <27>;
	};
};

&pmi8950_vadc {
	chan@10 {
		label = "bl_therm";
		reg = <0x10>;
		qcom,decimation = <0>;
		qcom,pre-div-channel-scaling = <0>;
		qcom,calibration-type = "ratiometric";
		qcom,scale-function = <27>;
		qcom,hw-settle-time = <2>;
		qcom,fast-avg-setup = <0>;
		qcom,vadc-thermal-node;
	};
};

/* Regulator config */
/* pm8950_s1 */
/* Follow QTI */

/* pm8950_s2 */
/* Follow QTI */

/* pm8950_s3 */
/* Follow QTI */

/* pm8950_s4 */
&pm8950_s4 {
	regulator-min-microvolt = <1800000>;
	regulator-max-microvolt = <1800000>;
	qcom,init-voltage = <1800000>;
};

/* pm8950_s5 */
/* Follow QTI */

/* pm8950_s6 */
/* Follow QTI */

&pm8950_l1 {
	regulator-min-microvolt = <900000>;
	regulator-max-microvolt = <1100000>;
	qcom,init-voltage = <1000000>;
	qcom,init-enable = <0>;
	qcom,init-ldo-mode = <1>;
	qcom,init-pin-ctrl-enable = <0>;
	qcom,init-pin-ctrl-mode = <0>;
	status = "okay";
};

/* pm8950_l2 */
/* Follow QTI */

&pm8950_l3 {
	regulator-min-microvolt = <1000000>;
	regulator-max-microvolt = <1200000>;
	qcom,init-voltage = <1100000>;
	qcom,init-enable = <0>;
	qcom,init-ldo-mode = <1>;
	qcom,init-pin-ctrl-enable = <0>;
	qcom,init-pin-ctrl-mode = <0>;
	status = "okay";
};

/* pm8950_l4 */
/* Follow QTI */

/* pm8950_l5 */
/* Follow QTI */

/* pm8950_l6 */
/* Follow QTI */

/* pm8950_l7 */
/* Follow QTI */

/* pm8950_l8 */
/* Follow QTI */

&pm8950_l9 {
	regulator-min-microvolt = <2000000>;
	regulator-max-microvolt = <2400000>;
	qcom,init-voltage = <2200000>;
	qcom,init-enable = <0>;
	qcom,init-ldo-mode = <1>;
	qcom,init-pin-ctrl-enable = <0>;
	qcom,init-pin-ctrl-mode = <0>;
	status = "okay";
};

&pm8950_l10 {
	regulator-min-microvolt = <2500000>;
	regulator-max-microvolt = <2900000>;
	qcom,init-voltage = <2700000>;
	qcom,init-enable = <0>;
	qcom,init-ldo-mode = <1>;
	qcom,init-pin-ctrl-enable = <0>;
	qcom,init-pin-ctrl-mode = <0>;
	status = "okay";
};

/* pm8950_l11 */
/* Follow QTI */

/* pm8950_l12 */
/* Follow QTI */

/* pm8950_l13 */
/* Follow QTI */

/* pm8950_l14 */
/* Follow QTI */

/* pm8950_l15 */
/* Follow QTI */

/* pm8950_l16 */
/* Follow QTI */

&pm8950_l17 {
	regulator-min-microvolt = <2500000>;
	regulator-max-microvolt = <2900000>;
	qcom,init-voltage = <2700000>;
	qcom,init-enable = <0>;
	qcom,init-ldo-mode = <1>;
	qcom,init-pin-ctrl-enable = <0>;
	qcom,init-pin-ctrl-mode = <0>;
	status = "okay";
};

/* pm8950_l18 */
/* Follow QTI */

/* pm8950_l19 */
/* Follow QTI */

/* pm8950_l20 */
/* Follow QTI */

/* pm8950_l21 */
/* Follow QTI */

&pm8950_l22 {
	regulator-min-microvolt = <3000000>;
	regulator-max-microvolt = <3000000>;
	qcom,init-voltage = <3000000>;
	qcom,init-enable = <0>;
	qcom,init-ldo-mode = <1>;
	qcom,init-pin-ctrl-enable = <0>;
	qcom,init-pin-ctrl-mode = <0>;
	status = "okay";
};

&pm8950_l23 {
	regulator-min-microvolt = <1200000>;
	regulator-max-microvolt = <1200000>;
	qcom,init-voltage = <1200000>;
	qcom,init-enable = <0>;
	qcom,init-ldo-mode = <1>;
	qcom,init-pin-ctrl-enable = <0>;
	qcom,init-pin-ctrl-mode = <0>;
	status = "okay";
};

/* pmi8950_VSW_WLED */
/* Follow QTI */

/* pmi8950_FLASH_OUT */
/* Follow QTI */

/* pm8004_s2 */
/* Follow QTI */

/* pm8004_s5 */
/* Follow QTI */

/* pm8004_VREG_L1 */
/* Follow QTI */

&msm_gpio {
	/* GPIO_0: FP_SPI_MOSI */
	/* This is handled by TZ side. */

	/* GPIO_1: FP_SPI_MISO */
	/* This is handled by TZ side. */

	/* GPIO_2: FP_SPI_CS_N */
	/* This is handled by TZ side. */

	/* GPIO_3: FP_SPI_CLK */
	/* This is handled by TZ side. */

	/* GPIO_4: BT_UART_TX */
	msm_gpio_4_act: msm_gpio_4_act {
		mux {
			pins = "gpio4";
			function = "blsp_uart2";
		};

		config {
			pins = "gpio4";
			drive-strength = <2>;
			bias-disable;
		};
	};

	msm_gpio_4_sus: msm_gpio_4_sus {
		mux {
			pins = "gpio4";
			function = "blsp_uart2";
		};

		config {
			pins = "gpio4";
			drive-strength = <2>;
			bias-disable;
			output-high;
		};
	};

	/* GPIO_5: BT_UART_RX */
	msm_gpio_5_def: msm_gpio_5_def {
		mux {
			pins = "gpio5";
			function = "blsp_uart2";
		};

		config {
			pins = "gpio5";
			drive-strength = <2>;
			bias-pull-up;
		};
	};

	/* GPIO_6: BT_UART_CTS_N */
	msm_gpio_6_def: msm_gpio_6_def {
		mux {
			pins = "gpio6";
			function = "blsp_uart2";
		};

		config {
			pins = "gpio6";
			drive-strength = <2>;
			bias-pull-up;
		};
	};

	/* GPIO_7: BT_UART_RTS_N */
	msm_gpio_7_act: msm_gpio_7_act {
		mux {
			pins = "gpio7";
			function = "blsp_uart2";
		};

		config {
			pins = "gpio7";
			drive-strength = <2>;
			bias-disable;
		};
	};

	msm_gpio_7_sus: msm_gpio_7_sus {
		mux {
			pins = "gpio7";
			function = "blsp_uart2";
		};

		config {
			pins = "gpio7";
			drive-strength = <2>;
			bias-disable;
			output-high;
		};
	};

	/* GPIO_8: SENSOR_SPI_MOSI */
	/* Kernel default setting will be overridden for SPI or I2C by ADSP SW. */
	msm_gpio_8_def: msm_gpio_8_def {
		mux {
			pins = "gpio8";
			function = "gpio";
		};

		config {
			pins = "gpio8";
			drive-strength = <2>;
			bias-disable;
			output-low;
		};
	};

	/* GPIO_9: SENSOR_SPI_MISO */
	/* Kernel default setting will be overridden for SPI or I2C by ADSP SW. */
	msm_gpio_9_def: msm_gpio_9_def {
		mux {
			pins = "gpio9";
			function = "gpio";
		};

		config {
			pins = "gpio9";
			drive-strength = <2>;
			bias-pull-down;
			input-enable;
		};
	};

	/* GPIO_10: SENSOR_SPI_CS_N_0 */
	/* Kernel default setting will be overridden for SPI or I2C by ADSP SW. */
	msm_gpio_10_def: msm_gpio_10_def {
		mux {
			pins = "gpio10";
			function = "gpio";
		};

		config {
			pins = "gpio10";
			drive-strength = <2>;
			bias-pull-down;
			input-enable;
		};
	};

	/* GPIO_11: SENSOR_SPI_CLK */
	/* Kernel default setting will be overridden for SPI or I2C by ADSP SW. */
	msm_gpio_11_def: msm_gpio_11_def {
		mux {
			pins = "gpio11";
			function = "gpio";
		};

		config {
			pins = "gpio11";
			drive-strength = <2>;
			bias-pull-down;
			input-enable;
		};
	};

	/* GPIO_12: NC(TS_SPI_MOSI) */
	msm_gpio_12_def: msm_gpio_12_def {
		mux {
			pins = "gpio12";
			function = "gpio";
		};

		config {
			pins = "gpio12";
			drive-strength = <2>;
			bias-disable;
			output-low;
		};
	};

	/* GPIO_13: NC(TS_SPI_MISO) */
	msm_gpio_13_def: msm_gpio_13_def {
		mux {
			pins = "gpio13";
			function = "gpio";
		};

		config {
			pins = "gpio13";
			drive-strength = <2>;
			bias-disable;
			output-low;
		};
	};

	/* GPIO_14: TS_I2C_SDA(TS_SPI_CS) */
	msm_gpio_14_def: msm_gpio_14_def {
		mux {
			pins = "gpio14";
			function = "blsp_i2c4";
		};

		config {
			pins = "gpio14";
			drive-strength = <2>;
			bias-disable;
		};
	};

	msm_gpio_14_sus: msm_gpio_14_sus {
		mux {
			pins = "gpio14";
			function = "blsp_i2c4";
		};

		config {
			pins = "gpio14";
			drive-strength = <2>;
			bias-disable;
		};
	};

	/* GPIO_15: TS_I2C_SCL(TS_SPI_CLK) */
	msm_gpio_15_def: msm_gpio_15_def {
		mux {
			pins = "gpio15";
			function = "blsp_i2c4";
		};

		config {
			pins = "gpio15";
			drive-strength = <2>;
			bias-disable;
		};
	};

	msm_gpio_15_sus: msm_gpio_15_sus {
		mux {
			pins = "gpio15";
			function = "blsp_i2c4";
		};

		config {
			pins = "gpio15";
			drive-strength = <2>;
			bias-disable;
		};
	};

	/* GPIO_16: NFC_DWLD_EN FELICA_PON */
	msm_gpio_16_def: msm_gpio_16_def {
		mux {
			pins = "gpio16";
			function = "gpio";
		};

		config {
			pins = "gpio16";
			drive-strength = <2>;
			bias-disable;
			output-low;
		};
	};

	/* GPIO_17: BT_HOST_WAKE */
	msm_gpio_17_act: msm_gpio_17_act {
		mux {
			pins = "gpio17";
			function = "gpio";
		};

		config {
			pins = "gpio17";
			drive-strength = <2>;
			bias-disable;
			input-enable;
		};
	};
	msm_gpio_17_sus: msm_gpio_17_sus {
		mux {
			pins = "gpio17";
			function = "gpio";
		};

		config {
			pins = "gpio17";
			drive-strength = <2>;
			bias-pull-down;
			input-enable;
		};
	};

	/* GPIO_18: BT_DEV_WAKE */
	msm_gpio_18_def: msm_gpio_18_def {
		mux {
			pins = "gpio18";
			function = "gpio";
		};

		config {
			pins = "gpio18";
			drive-strength = <2>;
			bias-disable;
			output-low;
		};
	};

	/* GPIO_19: BT_REG_ON */
	msm_gpio_19_def: msm_gpio_19_def {
		mux {
			pins = "gpio19";
			function = "gpio";
		};

		config {
			pins = "gpio19";
			drive-strength = <2>;
			bias-disable;
			output-low;
		};
	};

	/* GPIO_20: DEBUG_UART_TX */
	msm_gpio_20_def: msm_gpio_20_def {
		mux {
			pins = "gpio20";
			function = "blsp_uart6";
		};

		config {
			pins = "gpio20";
			drive-strength = <4>;
			bias-disable;
		};
	};

	/* GPIO_21: DEBUG_UART_RX */
	msm_gpio_21_def: msm_gpio_21_def {
		mux {
			pins = "gpio21";
			function = "blsp_uart6";
		};

		config {
			pins = "gpio21";
			drive-strength = <2>;
			bias-pull-up;
		};
	};

	/* GPIO_22: NFC_I2C_SDA */
	msm_gpio_22_def: msm_gpio_22_def {
		mux {
			pins = "gpio22";
			function = "blsp_i2c6";
		};

		config {
			pins = "gpio22";
			drive-strength = <2>;
			bias-disable;
		};
	};

	/* GPIO_23: NFC_I2C_SCL */
	msm_gpio_23_def: msm_gpio_23_def {
		mux {
			pins = "gpio23";
			function = "blsp_i2c6";
		};

		config {
			pins = "gpio23";
			drive-strength = <2>;
			bias-disable;
		};
	};

	/* GPIO_24: MDP_VSYNC_P */
	msm_gpio_24_def: msm_gpio_24_def {
		mux {
			pins = "gpio24";
			function = "mdp_vsync";
		};

		config {
			pins = "gpio24";
			drive-strength = <2>;
			bias-disable;
		};
	};

	/* GPIO_25: DISP_RESET_N */
	msm_gpio_25_def: msm_gpio_25_def {
		mux {
			pins = "gpio25";
			function = "gpio";
		};

		config {
			pins = "gpio25";
			drive-strength = <2>;
			bias-disable;
		};
	};

	/* GPIO_26: CAM0_MCLK */
	msm_gpio_26_def: msm_gpio_26_def {
		mux {
			pins = "gpio26";
			function = "cam_mclk";
		};

		config {
			pins = "gpio26";
			drive-strength = <2>;
			bias-disable;
		};
	};

	/* GPIO_27: NC(CAM1_MCLK) */
	msm_gpio_27_def: msm_gpio_27_def {
		mux {
			pins = "gpio27";
			function = "gpio";
		};

		config {
			pins = "gpio27";
			drive-strength = <2>;
			bias-disable;
			output-low;
		};
	};

	/* GPIO_28: CAM2_MCLK */
	msm_gpio_28_def: msm_gpio_28_def {
		mux {
			pins = "gpio28";
			function = "cam_mclk";
		};

		config {
			pins = "gpio28";
			drive-strength = <2>;
			bias-disable;
		};
	};

	/* GPIO_29: CCI_I2C_SDA0 */
	msm_gpio_29_def: msm_gpio_29_def {
		mux {
			pins = "gpio29";
			function = "cci0_i2c";
		};

		config {
			pins = "gpio29";
			drive-strength = <2>;
			bias-disable;
		};
	};

	/* GPIO_30: CCI_I2C_SCL0 */
	msm_gpio_30_def: msm_gpio_30_def {
		mux {
			pins = "gpio30";
			function = "cci0_i2c";
		};

		config {
			pins = "gpio30";
			drive-strength = <2>;
			bias-disable;
		};
	};

	/* GPIO_31: SENSOR_LDO_EN */
	msm_gpio_31_def: msm_gpio_31_def {
		mux {
			pins = "gpio31";
			function = "gpio";
		};

		config {
			pins = "gpio31";
			drive-strength = <2>;
			bias-disable;
			output-low;
		};
	};

	/* GPIO_32: FLASH_LED_NOW */
	msm_gpio_32_def: msm_gpio_32_def {
		mux {
			pins = "gpio32";
			function = "gpio";
		};

		config {
			pins = "gpio32";
			drive-strength = <2>;
			bias-pull-down;
			input-enable;
		};
	};

	/* GPIO_33: NFC_IRQ FELICA_INT */
	msm_gpio_33_def: msm_gpio_33_def {
		mux {
			pins = "gpio33";
			function = "gpio";
		};

		config {
			pins = "gpio33";
			drive-strength = <2>;
			bias-pull-down;
			input-enable;
		};
	};

	/* GPIO_34: NFC_VEN */
	msm_gpio_34_def: msm_gpio_34_def {
		mux {
			pins = "gpio34";
			function = "gpio";
		};

		config {
			pins = "gpio34";
			drive-strength = <2>;
			bias-disable;
			output-low;
		};
	};

	/* GPIO_35: CAM0_RESET_N */
	msm_gpio_35_def: msm_gpio_35_def {
		mux {
			pins = "gpio35";
			function = "gpio";
		};

		config {
			pins = "gpio35";
			drive-strength = <2>;
			bias-disable;
			output-low;
		};
	};

	/* GPIO_36: NC(CAM1_RESET_N) */
	msm_gpio_36_def: msm_gpio_36_def {
		mux {
			pins = "gpio36";
			function = "gpio";
		};

		config {
			pins = "gpio36";
			drive-strength = <2>;
			bias-disable;
			output-low;
		};
	};

	/* GPIO_37: FORCED_USB_BOOT */
	msm_gpio_37_def: msm_gpio_37_def {
		mux {
			pins = "gpio37";
			function = "gpio";
		};

		config {
			pins = "gpio37";
			drive-strength = <2>;
			bias-pull-down;
			input-enable;
		};
	};

	/* GPIO_38: CAM2_RESET_N */
	msm_gpio_38_def: msm_gpio_38_def {
		mux {
			pins = "gpio38";
			function = "gpio";
		};

		config {
			pins = "gpio38";
			drive-strength = <2>;
			bias-disable;
			output-low;
		};
	};

	/* GPIO_39: WLAN_SDIO_DATA_3 */
	msm_gpio_39_def: msm_gpio_39_def {
		mux {
			pins = "gpio39";
			function = "sdc3";
		};

		config {
			pins = "gpio39";
			drive-strength = <10>;
			bias-pull-up;
		};
	};

	/* GPIO_40: WLAN_SDIO_DATA_2 */
	msm_gpio_40_def: msm_gpio_40_def {
		mux {
			pins = "gpio40";
			function = "sdc3";
		};

		config {
			pins = "gpio40";
			drive-strength = <10>;
			bias-pull-up;
		};
	};

	/* GPIO_41: WLAN_SDIO_DATA_1 */
	msm_gpio_41_def: msm_gpio_41_def {
		mux {
			pins = "gpio41";
			function = "sdc3";
		};

		config {
			pins = "gpio41";
			drive-strength = <10>;
			bias-pull-up;
		};
	};

	/* GPIO_42: WLAN_SDIO_DATA_0 */
	msm_gpio_42_def: msm_gpio_42_def {
		mux {
			pins = "gpio42";
			function = "sdc3";
		};

		config {
			pins = "gpio42";
			drive-strength = <10>;
			bias-pull-up;
		};
	};

	/* GPIO_43: WLAN_SDIO_CMD */
	msm_gpio_43_def: msm_gpio_43_def {
		mux {
			pins = "gpio43";
			function = "sdc3";
		};

		config {
			pins = "gpio43";
			drive-strength = <10>;
			bias-pull-up;
		};
	};

	/* GPIO_44: WLAN_SDIO_CLK */
	msm_gpio_44_def: msm_gpio_44_def {
		mux {
			pins = "gpio44";
			function = "sdc3";
		};

		config {
			pins = "gpio44";
			drive-strength = <10>;
			bias-pull-up;
		};
	};

	/* GPIO_45: WL_HOST_WAKE */
	msm_gpio_45_def: msm_gpio_45_def {
		mux {
			pins = "gpio45";
			function = "gpio";
		};

		config {
			pins = "gpio45";
			drive-strength = <2>;
			bias-pull-down;
			input-enable;
		};
	};

	/* GPIO_46: LTE_COEX_TX */
	msm_gpio_46_def: msm_gpio_46_def {
		mux {
			pins = "gpio46";
			function = "gpio";
		};

		config {
			pins = "gpio46";
			drive-strength = <2>;
			bias-disable;
			output-low;
		};
	};

	/* GPIO_47: LTE_COEX_RX */
	msm_gpio_47_def: msm_gpio_47_def {
		mux {
			pins = "gpio47";
			function = "gpio";
		};

		config {
			pins = "gpio47";
			drive-strength = <2>;
			bias-pull-down;
			input-enable;
		};
	};

	/* GPIO_48: WL_REG_ON */
	msm_gpio_48_def: msm_gpio_48_def {
		mux {
			pins = "gpio48";
			function = "gpio";
		};

		config {
			pins = "gpio48";
			drive-strength = <2>;
			bias-disable;
			output-high;
		};
	};

	/* GPIO_49: RF_ID_0 */
	msm_gpio_49_def: msm_gpio_49_def {
		mux {
			pins = "gpio49";
			function = "gpio";
		};

		config {
			pins = "gpio49";
			drive-strength = <2>;
			bias-pull-up;
			input-enable;
		};
	};

	/* GPIO_50: RF_ID_1 */
	msm_gpio_50_def: msm_gpio_50_def {
		mux {
			pins = "gpio50";
			function = "gpio";
		};

		config {
			pins = "gpio50";
			drive-strength = <2>;
			bias-pull-up;
			input-enable;
		};
	};

	/* GPIO_51: HW_ID_0 */
	msm_gpio_51_def: msm_gpio_51_def {
		mux {
			pins = "gpio51";
			function = "gpio";
		};

		config {
			pins = "gpio51";
			drive-strength = <2>;
			bias-pull-up;
			input-enable;
		};
	};

	/* GPIO_52: HW_ID_1 */
	msm_gpio_52_def: msm_gpio_52_def {
		mux {
			pins = "gpio52";
			function = "gpio";
		};

		config {
			pins = "gpio52";
			drive-strength = <2>;
			bias-pull-up;
			input-enable;
		};
	};

	/* GPIO_53: UIM2_DATA */
	/* Follow QTI */

	/* GPIO_54: UIM2_CLK */
	/* Follow QTI */

	/* GPIO_55: UIM2_RESET */
	/* Follow QTI */

	/* GPIO_56: UIM2_PRESENT */
	msm_gpio_56_def: msm_gpio_56_def {
		mux {
			pins = "gpio56";
			function = "gpio";
		};

		config {
			pins = "gpio56";
			drive-strength = <2>;
			bias-disable;
			input-enable;
		};
	};

	/* GPIO_57: UIM1_DATA */
	/* Follow QTI */

	/* GPIO_58: UIM1_CLK */
	/* Follow QTI */

	/* GPIO_59: UIM1_RESET */
	/* Follow QTI */

	/* GPIO_60: UIM1_PRESENT */
	msm_gpio_60_def: msm_gpio_60_def {
		mux {
			pins = "gpio60";
			function = "gpio";
		};

		config {
			pins = "gpio60";
			drive-strength = <2>;
			bias-disable;
			input-enable;
		};
	};

	/* GPIO_61: BATT_UICC_ALARM */
	/* Follow QTI */

	/* GPIO_62: NC(DTV_RST_N) */
	msm_gpio_62_def: msm_gpio_62_def {
		mux {
			pins = "gpio62";
			function = "gpio";
		};

		config {
			pins = "gpio62";
			drive-strength = <2>;
			bias-disable;
			output-low;
		};
	};

	/* GPIO_63: NC(LCD_VDDIO_EN) */
	msm_gpio_63_def: msm_gpio_63_def {
		mux {
			pins = "gpio63";
			function = "gpio";
		};

		config {
			pins = "gpio63";
			drive-strength = <2>;
			bias-disable;
			output-low;
		};
	};

	/* GPIO_64: TS_RESET_N */
	msm_gpio_64_def: msm_gpio_64_def {
		mux {
			pins = "gpio64";
			function = "gpio";
		};

		config {
			pins = "gpio64";
			drive-strength = <2>;
		};
	};

	/* GPIO_65: TS_INT_N */
	msm_gpio_65_act: msm_gpio_65_act {
		mux {
			pins = "gpio65";
			function = "gpio";
		};

		config {
			pins = "gpio65";
			drive-strength = <2>;
			bias-pull-up;
			input-enable;
		};
	};

	msm_gpio_65_sus: msm_gpio_65_sus {
		mux {
			pins = "gpio65";
			function = "gpio";
		};

		config {
			pins = "gpio65";
			drive-strength = <2>;
			bias-pull-down;
			input-enable;
		};
	};

	msm_gpio_65_def: msm_gpio_65_def {
		mux {
			pins = "gpio65";
			function = "gpio";
		};

		config {
			pins = "gpio65";
			drive-strength = <2>;
			input-enable;
		};
	};

	/* GPIO_66: NC(DTV_LDO_EN) */
	msm_gpio_66_def: msm_gpio_66_def {
		mux {
			pins = "gpio66";
			function = "gpio";
		};

		config {
			pins = "gpio66";
			drive-strength = <2>;
			bias-disable;
			output-low;
		};
	};

	/* GPIO_67: NC(DTV_INT) */
	msm_gpio_67_def: msm_gpio_67_def {
		mux {
			pins = "gpio67";
			function = "gpio";
		};

		config {
			pins = "gpio67";
			drive-strength = <2>;
			bias-disable;
			output-low;
		};
	};

	/* GPIO_68: ACC_COVER_OPEN */
	msm_gpio_68_def: msm_gpio_68_def {
		mux {
			pins = "gpio68";
			function = "gpio";
		};

		config {
			pins = "gpio68";
			drive-strength = <2>;
			bias-disable;
			input-enable;
		};
	};

	/* GPIO_69: FP_RESET_N */
	msm_gpio_69_def: msm_gpio_69_def {
		mux {
			pins = "gpio69";
			function = "gpio";
		};

		config {
			pins = "gpio69";
			drive-strength = <2>;
			bias-disable;
			output-low;
		};
	};

	msm_gpio_69_output_high: msm_gpio_69_output_high {
		mux {
			pins = "gpio69";
			function = "gpio";
		};

		config {
			pins = "gpio69";
			drive-strength = <2>;
			bias-disable;
			output-high;
		};
	};

	/* GPIO_70: RFFE1_CLK */
	/* Follow QTI */

	/* GPIO_71: RFFE1_DATA */
	/* Follow QTI */

	/* GPIO_72: RFFE2_CLK */
	/* Follow QTI */

	/* GPIO_73: RFFE2_DATA */
	/* Follow QTI */

	/* GPIO_74: NC(RFFE3_CLK) */
	msm_gpio_74_def: msm_gpio_74_def {
		mux {
			pins = "gpio74";
			function = "gpio";
		};

		config {
			pins = "gpio74";
			drive-strength = <2>;
			bias-disable;
			output-low;
		};
	};

	/* GPIO_75: NC(RFFE3_DATA) */
	msm_gpio_75_def: msm_gpio_75_def {
		mux {
			pins = "gpio75";
			function = "gpio";
		};

		config {
			pins = "gpio75";
			drive-strength = <2>;
			bias-disable;
			output-low;
		};
	};

	/* GPIO_76: RFFE5_CLK */
	/* Follow QTI */

	/* GPIO_77: RFFE5_DATA */
	/* Follow QTI */

	/* GPIO_78: RFFE4_CLK */
	/* Follow QTI */

	/* GPIO_79: RFFE4_DATA */
	/* Follow QTI */

	/* GPIO_80: GRFC0 */
	/* Follow QTI */

	/* GPIO_81: GRFC1 */
	/* Follow QTI */

	/* GPIO_82: GRFC2 */
	/* Follow QTI */

	/* GPIO_83: GRFC3 */
	/* Follow QTI */

	/* GPIO_84: GRFC4(MSA_PK_HASH_IN_FUSE) */
	/* Follow QTI */

	/* GPIO_85: GRFC5(ALL_USE_SERIAL_NUMBER) */
	/* Follow QTI */

	/* GPIO_86: PROX_BAND_SEL(BOOT_CONFIG_0,WDOG_DISABLE) */
	/* Follow QTI */

	/* GPIO_87: GRFC7(BOOT_CONFIG_1/FAST_BOOT_SELECT_0) */
	/* Follow QTI */

	/* GPIO_88: GRFC8(BOOT_CONFIG_2/FAST_BOOT_SELECT_1) */
	/* Follow QTI */

	/* GPIO_89: GRFC9(BOOT_CONFIG_3/FAST_BOOT_SELECT_2) */
	/* Follow QTI */

	/* GPIO_90: MAIN_ANT_SW_SEL(GRFC10) */
	/* Follow QTI */

	/* GPIO_91: DIV_ANT_SW_SEL(GRFC11) */
	/* Follow QTI */

	/* GPIO_92: NC(TX_GTR_THRESH/GRFC12) */
	msm_gpio_92_def: msm_gpio_92_def {
		mux {
			pins = "gpio92";
			function = "gpio";
		};

		config {
			pins = "gpio92";
			drive-strength = <2>;
			bias-disable;
			output-low;
		};
	};

	/* GPIO_93: GRFC13 */
	/* Follow QTI */

	/* GPIO_94: NC(GRFC14) */
	msm_gpio_94_def: msm_gpio_94_def {
		mux {
			pins = "gpio94";
			function = "gpio";
		};

		config {
			pins = "gpio94";
			drive-strength = <2>;
			bias-disable;
			output-low;
		};
	};

	/* GPIO_95: NC(GSM_TX_PHASE_D0_WTR1) */
	msm_gpio_95_def: msm_gpio_95_def {
		mux {
			pins = "gpio95";
			function = "gpio";
		};

		config {
			pins = "gpio95";
			drive-strength = <2>;
			bias-disable;
			output-low;
		};
	};

	/* GPIO_96: NC(GRFC16) */
	msm_gpio_96_def: msm_gpio_96_def {
		mux {
			pins = "gpio96";
			function = "gpio";
		};

		config {
			pins = "gpio96";
			drive-strength = <2>;
			bias-disable;
			output-low;
		};
	};

	/* GPIO_97: NC(PK_HASH_INDEX_SRC) */
	msm_gpio_97_def: msm_gpio_97_def {
		mux {
			pins = "gpio97";
			function = "gpio";
		};

		config {
			pins = "gpio97";
			drive-strength = <2>;
			bias-disable;
			output-low;
		};
	};

	/* GPIO_98: EXT_GPS_LNA_EN */
	/* Follow QTI */

	/* GPIO_99: GSM_TX_PHASE */
	/* Follow QTI */

	/* GPIO_100: TRAY_DET */
	msm_gpio_100_def: msm_gpio_100_def {
		mux {
			pins = "gpio100";
			function = "gpio";
		};

		config {
			pins = "gpio100";
			drive-strength = <2>;
			bias-disable;
			input-enable;
		};
	};

	/* GPIO_101: SPKR_AMP_EN_2 */
	msm_gpio_101_def: msm_gpio_101_def {
		mux {
			pins = "gpio101";
			function = "gpio";
		};

		config {
			pins = "gpio101";
			drive-strength = <2>;
			bias-disable;
			output-low;
		};
	};

	/* GPIO_102: BT_PCM_DOUT */
	/* Configure at audio block */

	/* GPIO_103: CCI_I2C_SDA1 */
	msm_gpio_103_def: msm_gpio_103_def {
		mux {
			pins = "gpio103";
			function = "cci1_i2c";
		};

		config {
			pins = "gpio103";
			drive-strength = <2>;
			bias-disable;
		};
	};

	/* GPIO_104: CCI_I2C_SCL1 */
	msm_gpio_104_def: msm_gpio_104_def {
		mux {
			pins = "gpio104";
			function = "cci1_i2c";
		};

		config {
			pins = "gpio104";
			drive-strength = <2>;
			bias-disable;
		};
	};

	/* GPIO_105: BT_PCM_CLK */
	/* Configure at audio block */

	/* GPIO_106: FP_INT_N */
	msm_gpio_106_def: msm_gpio_106_def {
		mux {
			pins = "gpio106";
			function = "gpio";
		};

		config {
			pins = "gpio106";
			drive-strength = <2>;
			bias-pull-down;
			input-enable;
		};
	};

	/* GPIO_107: NC(SENSOR_SPI_CS_N_MAG) */
	msm_gpio_107_def: msm_gpio_107_def {
		mux {
			pins = "gpio107";
			function = "gpio";
		};

		config {
			pins = "gpio107";
			drive-strength = <2>;
			bias-pull-up;
			input-enable;
		};
	};

	/* GPIO_108: NC(DTV_SPI_MOSI) */
	msm_gpio_108_def: msm_gpio_108_def {
		mux {
			pins = "gpio108";
			function = "gpio";
		};

		config {
			pins = "gpio108";
			drive-strength = <2>;
			bias-disable;
			output-low;
		};
	};

	/* GPIO_109: NC(DTV_SPI_MISO) */
	msm_gpio_109_def: msm_gpio_109_def {
		mux {
			pins = "gpio109";
			function = "gpio";
		};

		config {
			pins = "gpio109";
			drive-strength = <2>;
			bias-disable;
			output-low;
		};
	};

	/* GPIO_110: NC(DTV_SPI_CS_N) */
	msm_gpio_110_def: msm_gpio_110_def {
		mux {
			pins = "gpio110";
			function = "gpio";
		};

		config {
			pins = "gpio110";
			drive-strength = <2>;
			bias-disable;
			output-low;
		};
	};

	/* GPIO_111: NC(DTV_SPI_CLK/FORCE_MSA_AUTH_EN) */
	msm_gpio_111_def: msm_gpio_111_def {
		mux {
			pins = "gpio111";
			function = "gpio";
		};

		config {
			pins = "gpio111";
			drive-strength = <2>;
			bias-disable;
			output-low;
		};
	};

	/* GPIO_112: FP_LDO_EN(AP_AUTH_EN) */
	msm_gpio_112_def: msm_gpio_112_def {
		mux {
			pins = "gpio112";
			function = "gpio";
		};

		config {
			pins = "gpio112";
			drive-strength = <2>;
			bias-disable;
			output-low;
		};
	};

	msm_gpio_112_enable: msm_gpio_112_enable {
		mux {
			pins = "gpio112";
			function = "gpio";
		};

		config {
			pins = "gpio112";
			drive-strength = <2>;
			bias-disable;
			output-high;
		};
	};

	/* GPIO_113: KEY_VOL_DOWN_N */
	/* Follow QTI */

	/* GPIO_114: KEY_FOCUS_N */
	/* Follow QTI */

	/* GPIO_115: KEY_SNAPSHOT_N */
	/* Follow QTI */

	/* GPIO_116: NC(CDC_MSM_MCLK) */
	msm_gpio_116_def: msm_gpio_116_def {
		mux {
			pins = "gpio116";
			function = "gpio";
		};

		config {
			pins = "gpio116";
			drive-strength = <2>;
			bias-disable;
			output-low;
		};
	};

	/* GPIO_117: SLIMBUS_CLK */
	/* Follow QTI */

	/* GPIO_118: SLIMBUS_DATA0 */
	/* Follow QTI */

	/* GPIO_119: SLIMBUS_DATA1 */
	/* Follow QTI */

	/* GPIO_120: CODEC_INT1_N */
	/* Follow QTI */

	/* GPIO_121: CODEC_INT2_N */
	/* Follow QTI */

	/* GPIO_122: LCD_ID_EN */
	msm_gpio_122_def: msm_gpio_122_def {
		mux {
			pins = "gpio122";
			function = "gpio";
		};

		config {
			pins = "gpio122";
			drive-strength = <2>;
			bias-disable;
			output-low;
		};
	};

	/* GPIO_123: FM_I2S_SYNC */
	/* Follow QTI */

	/* GPIO_124: FM_I2S_CLK */
	msm_gpio_124_def: msm_gpio_124_def {
		mux {
			pins = "gpio124";
			function = "gpio";
		};

		config {
			pins = "gpio124";
			drive-strength = <2>;
			bias-pull-down;
			input-enable;
		};
	};

	/* GPIO_125: FM_I2S_DATA */
	/* Follow QTI */

	/* GPIO_126: TP_VDDIO_EN */
	msm_gpio_126_def: msm_gpio_126_def {
		mux {
			pins = "gpio126";
			function = "gpio";
		};

		config {
			pins = "gpio126";
			drive-strength = <2>;
			bias-disable;
			output-low;
		};
	};

	/* GPIO_127: CAM_VDDIO_EN */
	msm_gpio_127_def: msm_gpio_127_def {
		mux {
			pins = "gpio127";
			function = "gpio";
		};

		config {
			pins = "gpio127";
			drive-strength = <2>;
			bias-disable;
			output-high;
		};
	};

	/* GPIO_128: SW_SERVICE */
	msm_gpio_128_def: msm_gpio_128_def {
		mux {
			pins = "gpio128";
			function = "gpio";
		};

		config {
			pins = "gpio128";
			drive-strength = <2>;
			bias-pull-up;
			input-enable;
		};
	};

	/* GPIO_129: UIM2_DETECT_EN */
	msm_gpio_129_def: msm_gpio_129_def {
		mux {
			pins = "gpio129";
			function = "gpio";
		};

		config {
			pins = "gpio129";
			drive-strength = <2>;
			bias-disable;
			output-low;
		};
	};

	/* GPIO_130: KEY_VOL_UP_N */
	msm_gpio_130_def: msm_gpio_130_def {
		mux {
			pins = "gpio130";
			function = "gpio";
		};

		config {
			pins = "gpio130";
			drive-strength = <2>;
			bias-pull-up;
			input-enable;
		};
	};

	/* GPIO_131: NC(USBPD_INT) */
	msm_gpio_131_def: msm_gpio_131_def {
		mux {
			pins = "gpio131";
			function = "gpio";
		};

		config {
			pins = "gpio131";
			drive-strength = <2>;
			bias-disable;
			output-low;
		};
	};

	/* GPIO_132: SPKR_AMP_EN_1 */
	msm_gpio_132_def: msm_gpio_132_def {
		mux {
			pins = "gpio132";
			function = "gpio";
		};

		config {
			pins = "gpio132";
			drive-strength = <2>;
			bias-disable;
			output-low;
		};
	};

	/* GPIO_133: CODEC_RESET_N */
	/* Follow QTI */

	/* GPIO_134: BT_PCM_SYNC */
	/* Configure at audio block */

	/* GPIO_135: BT_PCM_DIN */
	/* Configure at audio block */

	/* GPIO_136: SENSOR_I2C_SDA */
	msm_gpio_136_def: msm_gpio_136_def {
		mux {
			pins = "gpio136";
			function = "blsp_i2c5";
		};

		config {
			pins = "gpio136";
			drive-strength = <2>;
			bias-disable;
		};
	};

	/* GPIO_137: SENSOR_I2C_SCL */
	msm_gpio_137_def: msm_gpio_137_def {
		mux {
			pins = "gpio137";
			function = "blsp_i2c5";
		};

		config {
			pins = "gpio137";
			drive-strength = <2>;
			bias-disable;
		};
	};

	/* GPIO_138: ACCEL_INT(ACCEL_DRDY_INT) */
	/* Follow QTI */

	/* GPIO_139: GYRO_INT(GYRO_DRDY_INT) */
	/* Follow QTI */

	/* GPIO_140: BAROMETER_INT(PRESS_DRDY_INT) */
	/* Follow QTI */

	/* GPIO_141: ALS_PROX_INT(ALPS_INT_N) */
	msm_gpio_141_def: msm_gpio_141_def {
		mux {
			pins = "gpio141";
			function = "gpio";
		};

		config {
			pins = "gpio141";
			drive-strength = <2>;
			bias-disable;
			input-enable;
		};
	};

	/* GPIO_142: COMPASS_INT(MAG_DRDY_INT) */
	/* Follow QTI */

	/* GPIO_143: EAR_EN */
	msm_gpio_143_def: msm_gpio_143_def {
		mux {
			pins = "gpio143";
			function = "gpio";
		};

		config {
			pins = "gpio143";
			drive-strength = <2>;
			bias-disable;
			output-low;
		};
	};

	/* GPIO_144: PROX_DET */
	msm_gpio_144_def: msm_gpio_144_def {
		mux {
			pins = "gpio144";
			function = "gpio";
		};

		config {
			pins = "gpio144";
			drive-strength = <2>;
			bias-disable;
			output-low;
		};
	};

	wsa_spkr_sd_act: spkr_lines_on {
		mux {
			pins = "gpio132", "gpio101";
			function = "gpio";
		};
		config {
			pins = "gpio132", "gpio101";
			drive-strength = <2>;
			output-high;
			bias-pull-down;
		};
	};

	wsa_spkr_sd_sus: spkr_lines_off {
		mux {
			pins = "gpio132", "gpio101";
			function = "gpio";
		};
		config {
			pins = "gpio132", "gpio101";
			drive-strength = <2>;
			output-low;
			bias-disable;
		};
	};

	sec_tlmm_lines_act: sec_tlmm_lines_act {
		mux {
			pins = "gpio102", "gpio105";
			function = "sec_mi2s";
		};
		config {
			pins = "gpio102", "gpio105";
			drive-strength = <8>;
		};
	};

	sec_tlmm_lines_sus: sec_tlmm_lines_sus {
		mux {
			pins = "gpio102", "gpio105";
			function = "sec_mi2s";
		};
		config {
			pins = "gpio102", "gpio105";
			drive-strength = <2>;
			bias-pull-down;
		};
	};

	sec_tlmm_2_lines_act: sec_tlmm_2_lines_act {
		mux {
			pins = "gpio134", "gpio135";
			function = "sec_mi2s";
		};
		config {
			pins = "gpio134", "gpio135";
			drive-strength = <8>;
		};
	};

	sec_tlmm_2_lines_sus: sec_tlmm_2_lines_sus {
		mux {
			pins = "gpio134", "gpio135";
			function = "sec_mi2s";
		};
		config {
			pins = "gpio134", "gpio135";
			drive-strength = <2>;
			bias-pull-down;
		};
	};

	cam_sensor_rear_default: cam_sensor_rear_default {
		/* RESET */
		mux {
			pins = "gpio35";
			function = "gpio";
		};

		config {
			pins = "gpio35";
		};
	};

	cam_sensor_rear_sleep: cam_sensor_rear_sleep {
		/* RESET */
		mux {
			pins = "gpio35";
			function = "gpio";
		};

		config {
			pins = "gpio35";
		};
	};

	cam_sensor_front_default: cam_sensor_front_default {
		/* RESET */
		mux {
			pins = "gpio38";
			function = "gpio";
		};

		config {
			pins = "gpio38";
		};
	};

	cam_sensor_front_sleep: cam_sensor_front_sleep {
		/* RESET */
		mux {
			pins = "gpio38";
			function = "gpio";
		};

		config {
			pins = "gpio38";
		};
	};
};

&msm_dai_mi2s {
	dai_mi2s5 {
		qcom,msm-dai-q6-mi2s-dev-id = <5>;
		qcom,msm-mi2s-rx-lines = <0>;
		qcom,msm-mi2s-tx-lines = <1>;
	};
};

&slim_msm {
	tasha_codec {
		qcom,cdc-micbias1-mv = <1800>;
		qcom,cdc-micbias2-mv = <1800>;
		qcom,cdc-micbias3-mv = <1800>;
		qcom,cdc-micbias4-mv = <1800>;
		qcom,cdc-dmic-sample-rate = <2400000>;
	};
};

&ext_codec {
	qcom,msm-mbhc-hphl-swh = <1>;
	/delete-property/ qcom,cdc-us-euro-gpios;
	/delete-property/ qcom,cdc-us-eu-gpios;
	qcom,ear-en-gpios = <&msm_gpio 143 0>;
	qcom,audio-routing =
		"AIF4 VI", "MCLK",
		"RX_BIAS", "MCLK",
		"MADINPUT", "MCLK",
		"AMIC2", "MIC BIAS2",
		"MIC BIAS2", "Headset Mic",
		"MIC BIAS2", "ANCRight Headset Mic",
		"AMIC3", "MIC BIAS3",
		"MIC BIAS3", "ANCLeft Headset Mic",
		"DMIC0", "MIC BIAS1",
		"MIC BIAS1", "Digital Mic0",
		"DMIC3", "MIC BIAS4",
		"MIC BIAS4", "Digital Mic3",
		"SpkrLeft IN", "SPK1 OUT",
		"SpkrRight IN", "SPK2 OUT";
	qcom,msm-ext-pa = "quaternary", "quinary";
	qcom,quin-mi2s-gpios = <&cdc_quin_mi2s_gpios>;
	qcom,quat-mi2s-gpios = <&cdc_quat_mi2s_gpios>;
};

&wsa881x_211 {
	/delete-property/ qcom,spkr-sd-n-node;
	qcom,spkr-sd-n-gpio = <&msm_gpio 132 0>;
};

&wsa881x_212 {
	/delete-property/ qcom,spkr-sd-n-node;
	qcom,spkr-sd-n-gpio = <&msm_gpio 101 0>;
};

&wsa881x_213 {
	status = "disabled";
};

&wsa881x_214 {
	status = "disabled";
};

&cdc_us_euro_sw {
	status = "disabled";
};

/* LS UART : BLSP2 */
&blsp1_uart2 {
	status = "disabled";
};

/* I2C : BLSP2 */
&i2c_2 {
	status = "disabled";
};

/* I2C : BLSP6(NFC) */
&i2c_6 {
	/delete-node/ nq@2b;
};

/* I2C : BLSP8 */
&i2c_8 {
	status = "disabled";
};

&mdss_fb0 {
	/delete-property/ qcom,mdss-fb-splash-logo-enabled;
};

&mdss_dsi_active {
	mux {
		pins = "gpio25";
		function = "gpio";
	};
	config {
		pins = "gpio25";
		drive-strength = <2>; /* 2 mA */
		bias-disable = <0>; /* no pull */
		output-high;
	};
};

&mdss_dsi_suspend {
	mux {
		pins = "gpio25";
		function = "gpio";
	};
	config {
		pins = "gpio25";
		drive-strength = <2>; /* 2 mA */
		/delete-property/ bias-pull-down;
		bias-disable = <0>; /* no pull */
		output-low;
	};
};

&mdss_dsi {
	hw-config = "single_dsi";
};

&mdss_dsi0 {
	qcom,dsi-pref-prim-pan = <&dsi_default_panel>;
	pinctrl-names = "mdss_default", "mdss_sleep", "mdss_touch_active", "mdss_touch_suspend";
	pinctrl-0 = <&mdss_dsi_active &mdss_te_active>;
	pinctrl-1 = <&mdss_dsi_suspend &mdss_te_suspend>;
	pinctrl-2 = <&msm_gpio_65_act>;
	pinctrl-3 = <&msm_gpio_65_sus>;

	qcom,platform-reset-gpio = <&msm_gpio 25 0>;
	qcom,platform-touch-vddio-gpio = <&msm_gpio 126 0>;
	qcom,platform-touch-reset-gpio = <&msm_gpio 64 0>;
	qcom,platform-touch-int-gpio = <&msm_gpio 65 0>;
	/delete-property/ qcom,platform-bklight-en-gpio;
	/delete-property/ qcom,panel-mode-gpio;
};

&mdss_dsi1 {
	status = "disabled";
};

&labibb {
	qcom,lab@de00 {
		qcom,qpnp-lab-init-voltage = <6000000>;
		qcom,qpnp-lab-init-lcd-voltage = <6000000>;
		interrupts = <0x3 0xde 0x0 IRQ_TYPE_LEVEL_LOW>;
		interrupt-names = "lab_vreg_not_ok_interrupt";
	};
	qcom,ibb@dc00 {
		qcom,qpnp-ibb-init-voltage = <6000000>;
		qcom,qpnp-ibb-init-lcd-voltage = <6000000>;
		interrupts = <0x3 0xdc 0x0 IRQ_TYPE_LEVEL_HIGH>;
		interrupt-names = "ibb_vreg_not_ok_interrupt";
	};
};

&pri_tlmm_lines_sus {
	mux {
		function = "gpio";
	};
	config {
		input-enable;
	};
};

&sdc2_clk_on {
	config {
		drive-strength = <10>; /* 10 MA */
	};
};

&cam_sensor_mclk0_sleep {
	config {
		/delete-property/ bias-pull-down;
		bias-disable;
		output-low;
	};
};

&cam_sensor_mclk2_sleep {
	config {
		/delete-property/ bias-pull-down;
		bias-disable;
		output-low;
	};
};

&cci0_suspend {
	config {
		/delete-property/ bias-disable;
		bias-pull-down;
		input-enable;
	};
};

&cci1_suspend {
	config {
		/delete-property/ bias-disable;
		bias-pull-down;
		input-enable;
	};
};

&cci {
	qcom,i2c_standard_mode {
		qcom,hw-thigh = <43>;
		qcom,hw-tlow = <64>;
		qcom,hw-tsu-sto = <41>;
		qcom,hw-tsu-sta = <41>;
		qcom,hw-thd-dat = <25>;
		qcom,hw-thd-sta = <35>;
		qcom,hw-tbuf = <64>;
		qcom,cci-clk-src = <37500000>;
	};

	qcom,i2c_fast_mode {
		qcom,hw-thigh = <22>;
		qcom,hw-tlow = <33>;
	};

	qcom,camera@0 {
		cell-index = <0>;
		compatible = "qcom,sony_camera_0";
		reg = <0x0>;
		status = "ok";
		qcom,slave-id = <0x20 0x0 0x0000>;
		qcom,csiphy-sd-index = <0>;
		qcom,csid-sd-index = <0>;
		qcom,mount-angle = <0>;
		qcom,sensor-name = "sony_camera_0";
		cam_vdig-supply = <&pm8950_l3>;
		cam_vio-supply = <&pm8950_l5>;
		cam_vana-supply = <&pm8950_l9>;
		cam_vaf-supply = <&pm8950_l17>;
		qcom,cam-vreg-name = "cam_vdig", "cam_vio", "cam_vana", "cam_vaf";
		qcom,cam-vreg-type = <0 1 0 0>;
		qcom,cam-vreg-min-voltage = <1100000 0 2200000 2700000>;
		qcom,cam-vreg-max-voltage = <1100000 0 2200000 2700000>;
		qcom,cam-vreg-op-mode = <615000 0 89600 150000>;
		qcom,gpio-no-mux = <0>;
		pinctrl-names = "cam_default", "cam_suspend";
		pinctrl-0 = <&cam_sensor_mclk0_default &cam_sensor_rear_default>;
		pinctrl-1 = <&cam_sensor_mclk0_sleep &cam_sensor_rear_sleep>;
		gpios = <&msm_gpio 26 0>, <&msm_gpio 35 0>, <&msm_gpio 127 0>;
		qcom,gpio-reset = <1>;
		qcom,gpio-vio = <2>;
		qcom,gpio-req-tbl-num = <0 1 2>;
		qcom,gpio-req-tbl-flags = <1 0 0>;
		qcom,gpio-req-tbl-label = "CAMIF_MCLK0", "CAM_RESET0", "CAM_VIO";
		qcom,csi-lane-assign = <0x4320>;
		qcom,csi-lane-mask = <0x1F>;
		qcom,sensor-position = <0>;
		qcom,sensor-mode = <1>;
		qcom,cci-master = <0>;
		clocks = <&clock_gcc clk_mclk0_clk_src>, <&clock_gcc clk_gcc_camss_mclk0_clk>;
		clock-names = "cam_src_clk", "cam_clk";
		qcom,clock-rates = <24000000 0>;
		sony,i2c_addr = <0x20>;
		sony,eeprom_addr = <0xA0>;
		sony,eeprom_type = <0>;
		sony,eeprom_max_len = <2048>;
		sony,subdev_code = <0x3007>;
		sony_camera_module_0: sony,camera_modules {
		    status = "disabled";
		};
	};

	qcom,camera@1 {
		cell-index = <1>;
		compatible = "qcom,sony_camera_1";
		reg = <0x1>;
		status = "ok";
		qcom,slave-id = <0x34 0x0000 0x0000>;
		qcom,csiphy-sd-index = <1>;
		qcom,csid-sd-index = <1>;
		qcom,mount-angle = <0>;
		qcom,sensor-name = "sony_camera_1";
		cam_vdig-supply = <&pm8950_l1>;
		cam_vana-supply = <&pm8950_l10>;
		cam_vio-supply = <&pm8950_l5>;
		cam_vaf-supply = <&pm8950_l17>;
		qcom,cam-vreg-name = "cam_vdig", "cam_vana", "cam_vio", "cam_vaf";
		qcom,cam-vreg-type = <0 0 1 0>;
		qcom,cam-vreg-min-voltage = <1000000 2700000 0 2700000>;
		qcom,cam-vreg-max-voltage = <1000000 2700000 0 2700000>;
		qcom,cam-vreg-op-mode = <333000 46000 0 100000>;
		qcom,gpio-no-mux = <0>;
		pinctrl-names = "cam_default", "cam_suspend";
		pinctrl-0 = <&cam_sensor_mclk2_default &cam_sensor_front1_default>;
		pinctrl-1 = <&cam_sensor_mclk2_sleep &cam_sensor_front1_sleep>;
		gpios = <&msm_gpio 28 0>, <&msm_gpio 38 0>, <&msm_gpio 127 0>;
		qcom,gpio-reset = <1>;
		qcom,gpio-vio = <2>;
		qcom,gpio-req-tbl-num = <0 1 2>;
		qcom,gpio-req-tbl-flags = <1 0 0>;
		qcom,gpio-req-tbl-label = "CAMIF_MCLK2", "CAM_RESET2", "CAM_VIO";
		qcom,csi-lane-assign = <0x4320>;
		qcom,csi-lane-mask = <0x1F>;
		qcom,sensor-position = <1>;
		qcom,sensor-mode = <1>;
		qcom,cci-master = <1>;
		clocks = <&clock_gcc clk_mclk2_clk_src>, <&clock_gcc clk_gcc_camss_mclk2_clk>;
		clock-names = "cam_src_clk", "cam_clk";
		qcom,clock-rates = <24000000 0>;
		sony,i2c_addr = <0x34>;
		sony,eeprom_addr = <0xA0>;
		sony,eeprom_type = <0>;
		sony,eeprom_max_len = <2048>;
		sony,subdev_code = <0x3007>;
		sony_camera_module_1: sony,camera_modules {
		    status = "disabled";
		};
	};
};

&sony_camera_module_0 {
	module_names = "GENERIC", "SOI25BS4";
	default_module_name = "SOI25BS4";
	status = "ok";

	GENERIC {
		mount_angle = <270>;
		sensor_rotation = <180>;
		sensor_facing = <0>;
		total_pixel_number_w = <6048>;
		total_pixel_number_h = <4264>;
		active_pixel_number_x = <56>;
		active_pixel_number_y = <88>;
		active_pixel_number_w = <5984>;
		active_pixel_number_h = <4160>;
		min_focus_distance = <120>;
		hyper_focal_distance = <3679>;
		diagonal_len = "8.17";
		unit_cell_size_w = "1.12";
		unit_cell_size_h = "1.12";
		min_f_number = "2.00";
		max_f_number = "2.00";
		has_3a = <0>;
		has_focus_actuator = <1>;
		need_standby_af = <0>;
		i2c_freq_mode = <3>;
		has_pdaf = <1>;
		has_rs = <1>;
		pdaf_free_area_num = <8>;
		pdaf_fixed_area_size_w = <16>;
		pdaf_fixed_area_size_h = <12>;
		pll_num = <26>;
		pll = <145 109 112 112 122 109 182 75 112 136 145 182 182 145 142 145 104 182 145 145 182 182 182 182 104 112>;
		power_off {
			commands =
				"GPIO_RESET",
				"CAM_CLK",
				"CAM_VDIG",
				"CAM_VIO",
				"CAM_VANA",
				"CAM_VAF",
				"EXIT";
			CAM_VDIG = <0 0xFFFFFFFF 0 1>;
			CAM_VIO = <1 0xFFFFFFFF 0 1>;
			CAM_VANA = <2 0xFFFFFFFF 0 1>;
			CAM_VAF = <3 0xFFFFFFFF 0 0>;
			GPIO_RESET = <8 0x0 0 5>;
			CAM_CLK = <9 0xFFFFFFFF 0 0>;
			EXIT = <11 0x0 0 0>;
		};
		power_on {
			commands =
				"CAM_VDIG",
				"CAM_VIO",
				"CAM_VANA",
				"CAM_VAF",
				"CAM_CLK",
				"GPIO_RESET",
				"EXIT";
			CAM_VDIG = <0 1100 615000 0>;
			CAM_VIO = <1 0 0 0>;
			CAM_VANA = <2 2200 89600 0>;
			CAM_VAF = <3 2700 150000 3>;
			CAM_CLK = <9 0 0 1>;
			GPIO_RESET = <8 1 0 9>;
			EXIT = <11 0x0 0 0>;
		};
	};
	SOI25BS4 {
		mount_angle = <270>;
		sensor_rotation = <180>;
		sensor_facing = <0>;
		total_pixel_number_w = <6048>;
		total_pixel_number_h = <4264>;
		active_pixel_number_x = <56>;
		active_pixel_number_y = <88>;
		active_pixel_number_w = <5984>;
		active_pixel_number_h = <4160>;
		min_focus_distance = <120>;
		hyper_focal_distance = <3679>;
		diagonal_len = "8.17";
		unit_cell_size_w = "1.12";
		unit_cell_size_h = "1.12";
		min_f_number = "2.00";
		max_f_number = "2.00";
		has_3a = <0>;
		has_focus_actuator = <1>;
		need_standby_af = <0>;
		i2c_freq_mode = <3>;
		has_pdaf = <1>;
		has_rs = <1>;
		pdaf_free_area_num = <8>;
		pdaf_fixed_area_size_w = <16>;
		pdaf_fixed_area_size_h = <12>;
		pll_num = <26>;
		pll = <145 109 112 112 122 109 182 75 112 136 145 182 182 145 142 145 104 182 145 145 182 182 182 182 104 112>;
		power_off {
			commands =
				"GPIO_RESET",
				"CAM_CLK",
				"CAM_VDIG",
				"CAM_VIO",
				"CAM_VANA",
				"CAM_VAF",
				"EXIT";
			CAM_VDIG = <0 0xFFFFFFFF 0 1>;
			CAM_VIO = <1 0xFFFFFFFF 0 1>;
			CAM_VANA = <2 0xFFFFFFFF 0 1>;
			CAM_VAF = <3 0xFFFFFFFF 0 0>;
			GPIO_RESET = <8 0x0 0 5>;
			CAM_CLK = <9 0xFFFFFFFF 0 0>;
			EXIT = <11 0x0 0 0>;
		};
		power_on {
			commands =
				"CAM_VDIG",
				"CAM_VIO",
				"CAM_VANA",
				"CAM_VAF",
				"CAM_CLK",
				"GPIO_RESET",
				"EXIT";
			CAM_VDIG = <0 1100 85000 0>;
			CAM_VIO = <1 0 0 0>;
			CAM_VANA = <2 2200 103000 0>;
			CAM_VAF = <3 2700 106500 3>;
			CAM_CLK = <9 0 0 1>;
			GPIO_RESET = <8 1 0 9>;
			EXIT = <11 0x0 0 0>;
		};
	};
};

&sony_camera_module_1 {
	module_names = "GENERIC", "SOI13BS0", "SEM13BS0";
	default_module_name = "SOI13BS0";
	status = "ok";

	GENERIC {
		mount_angle = <270>;
		sensor_rotation = <180>;
		sensor_facing = <1>;
		total_pixel_number_w = <4224>;
		total_pixel_number_h = <3200>;
		active_pixel_number_x = <8>;
		active_pixel_number_y = <72>;
		active_pixel_number_w = <4208>;
		active_pixel_number_h = <3120>;
		min_focus_distance = <100>;
		hyper_focal_distance = <2000>;
		diagonal_len = "5.867";
		unit_cell_size_w = "1.12";
		unit_cell_size_h = "1.12";
		min_f_number = "2.00";
		max_f_number = "2.00";
		has_3a = <0>;
		has_focus_actuator = <1>;
		need_standby_af = <1>;
		i2c_freq_mode = <0>;
		has_pdaf = <0>;
		has_rs = <1>;
		pdaf_free_area_num = <0>;
		pdaf_fixed_area_size_w = <0>;
		pdaf_fixed_area_size_h = <0>;
		pll_num = <26>;
		pll = <1134 1134 1134 1134 1134 1134 1134 1134 1134 1134 1134 1134 1134 1134 1134 1134 1134 1134 1134 1134 1134 1134 1134 1134 1134 1134>;
		power_off {
			commands =
				"CAM_CLK",
				"GPIO_RESET",
				"CAM_VDIG",
				"CAM_VIO",
				"CAM_VANA",
				"CAM_VAF",
				"EXIT";
			CAM_VDIG = <0 0xFFFFFFFF 0 2>;
			CAM_VIO = <1 0xFFFFFFFF 0 2>;
			CAM_VANA = <2 0xFFFFFFFF 0 2>;
			CAM_VAF = <3 0xFFFFFFFF 0 0>;
			GPIO_RESET = <8 0x0 0 5>;
			CAM_CLK = <9 0xFFFFFFFF 0 0>;
			EXIT = <11 0x0 0 0>;
		};
		power_on {
			commands =
				"CAM_VDIG",
				"CAM_VIO",
				"CAM_VANA",
				"CAM_VAF",
				"CAM_CLK",
				"GPIO_RESET",
				"EXIT";
			CAM_VDIG = <0 1000 333000 0>;
			CAM_VIO = <1 0 0 0>;
			CAM_VANA = <2 2700 46000 0>;
			CAM_VAF = <3 2700 100000 3>;
			CAM_CLK = <9 0 0 1>;
			GPIO_RESET = <8 1 0 1>;
			EXIT = <11 0x0 0 0>;
		};
	};
	SOI13BS0 {
		mount_angle = <270>;
		sensor_rotation = <180>;
		sensor_facing = <1>;
		total_pixel_number_w = <4224>;
		total_pixel_number_h = <3200>;
		active_pixel_number_x = <8>;
		active_pixel_number_y = <72>;
		active_pixel_number_w = <4208>;
		active_pixel_number_h = <3120>;
		min_focus_distance = <100>;
		hyper_focal_distance = <2000>;
		diagonal_len = "5.867";
		unit_cell_size_w = "1.12";
		unit_cell_size_h = "1.12";
		min_f_number = "2.00";
		max_f_number = "2.00";
		has_3a = <0>;
		has_focus_actuator = <1>;
		need_standby_af = <1>;
		i2c_freq_mode = <0>;
		has_pdaf = <0>;
		has_rs = <1>;
		pdaf_free_area_num = <0>;
		pdaf_fixed_area_size_w = <0>;
		pdaf_fixed_area_size_h = <0>;
		pll_num = <26>;
		pll = <1134 1134 1134 1134 1134 1134 1134 1134 1134 1134 1134 1134 1134 1134 1134 1134 1134 1134 1134 1134 1134 1134 1134 1134 1134 1134>;
		power_off {
			commands =
				"CAM_CLK",
				"GPIO_RESET",
				"CAM_VDIG",
				"CAM_VIO",
				"CAM_VANA",
				"CAM_VAF",
				"EXIT";
			CAM_VDIG = <0 0xFFFFFFFF 0 2>;
			CAM_VIO = <1 0xFFFFFFFF 0 2>;
			CAM_VANA = <2 0xFFFFFFFF 0 2>;
			CAM_VAF = <3 0xFFFFFFFF 0 0>;
			GPIO_RESET = <8 0x0 0 5>;
			CAM_CLK = <9 0xFFFFFFFF 0 0>;
			EXIT = <11 0x0 0 0>;
		};
		power_on {
			commands =
				"CAM_VDIG",
				"CAM_VIO",
				"CAM_VANA",
				"CAM_VAF",
				"CAM_CLK",
				"GPIO_RESET",
				"EXIT";
			CAM_VDIG = <0 1000 333000 0>;
			CAM_VIO = <1 0 0 0>;
			CAM_VANA = <2 2700 46000 0>;
			CAM_VAF = <3 2700 100000 3>;
			CAM_CLK = <9 0 0 1>;
			GPIO_RESET = <8 1 0 1>;
			EXIT = <11 0x0 0 0>;
		};
	};
	SEM13BS0 {
		mount_angle = <270>;
		sensor_rotation = <180>;
		sensor_facing = <1>;
		total_pixel_number_w = <4224>;
		total_pixel_number_h = <3200>;
		active_pixel_number_x = <8>;
		active_pixel_number_y = <72>;
		active_pixel_number_w = <4208>;
		active_pixel_number_h = <3120>;
		min_focus_distance = <100>;
		hyper_focal_distance = <2000>;
		diagonal_len = "5.867";
		unit_cell_size_w = "1.12";
		unit_cell_size_h = "1.12";
		min_f_number = "2.00";
		max_f_number = "2.00";
		has_3a = <0>;
		has_focus_actuator = <1>;
		need_standby_af = <1>;
		i2c_freq_mode = <0>;
		has_pdaf = <0>;
		has_rs = <1>;
		pdaf_free_area_num = <0>;
		pdaf_fixed_area_size_w = <0>;
		pdaf_fixed_area_size_h = <0>;
		pll_num = <26>;
		pll = <1134 1134 1134 1134 1134 1134 1134 1134 1134 1134 1134 1134 1134 1134 1134 1134 1134 1134 1134 1134 1134 1134 1134 1134 1134 1134>;
		power_off {
			commands =
				"CAM_CLK",
				"GPIO_RESET",
				"CAM_VDIG",
				"CAM_VIO",
				"CAM_VANA",
				"CAM_VAF",
				"EXIT";
			CAM_VDIG = <0 0xFFFFFFFF 0 2>;
			CAM_VIO = <1 0xFFFFFFFF 0 2>;
			CAM_VANA = <2 0xFFFFFFFF 0 2>;
			CAM_VAF = <3 0xFFFFFFFF 0 0>;
			GPIO_RESET = <8 0x0 0 5>;
			CAM_CLK = <9 0xFFFFFFFF 0 0>;
			EXIT = <11 0x0 0 0>;
		};
		power_on {
			commands =
				"CAM_VDIG",
				"CAM_VIO",
				"CAM_VANA",
				"CAM_VAF",
				"CAM_CLK",
				"GPIO_RESET",
				"EXIT";
			CAM_VDIG = <0 1000 333000 0>;
			CAM_VIO = <1 0 0 0>;
			CAM_VANA = <2 2700 46000 0>;
			CAM_VAF = <3 2700 100000 3>;
			CAM_CLK = <9 0 0 1>;
			GPIO_RESET = <8 1 0 1>;
			EXIT = <11 0x0 0 0>;
		};
	};
};

&spmi_bus {
	qcom,pm8950@0 {
		qcom,leds@a300 {
			status = "disabled";
		};
		qcom,power-on@800 {
			qcom,s3-debounce = <16>;
			qcom,s3-src = "resin";
			qcom,pon_2 {
				linux,code = <115>;
			};
		};
	};

	qcom,pmi8950@2 {
		qcom,leds@a100 {
			status = "disabled";
		};
		qcom,power-on@800 {
			qcom,s3-debounce = <128>;
			qcom,s3-src = "kpdpwr-and-resin";
		};
	};
};

&sdhc_2 {
	cd-gpios = <&msm_gpio 100 0x0>;
	uim2-gpios = <&msm_gpio 129 0x0>;
	qcom,msm-bus,num-cases = <10>;
	qcom,msm-bus,vectors-KBps = <81 512 0 0>, /* No vote */
		<81 512 1046 3200>,    /* 400 KB/s*/
		<81 512 52286 160000>, /* 20 MB/s */
		<81 512 65360 200000>, /* 25 MB/s */
		<81 512 104572 320000>, /* 40 MB/s */
		<81 512 130718 400000>, /* 50 MB/s */
		<81 512 209144 640000>, /* 80 MB/s */
		<81 512 261438 800000>, /* 100 MB/s */
		<81 512 261438 800000>, /* 200 MB/s */
		<81 512 1338562 4096000>; /* Max. bandwidth */
	qcom,bus-bw-vectors-bps = <0 400000 20000000 25000000 40000000 50000000
				80000000 100000000 200000000 4294967295>;
	qcom,clk-rates = <400000 25000000 40000000 50000000 80000000 100000000 200000000>;
};

&sdhc_3 {
	interrupt-map = <0 &intc 0 295 0
		1 &intc 0 297 0
		2 &msm_gpio 41 0x8>;

	/delete-property/ qcom,core_3_0v_support;
	/delete-property/ qcom,nonremovable;

	qcom,vdd-io-current-level = <200 22000>;

	pinctrl-names = "active", "sleep";
	pinctrl-0 = <&sdc3_clk_on &sdc3_cmd_on &sdc3_dat_on>;
	pinctrl-1 = <&sdc3_clk_off &sdc3_cmd_off &sdc3_dat_off>;

	somc,use-for-wifi;

	status = "ok";
};

&other_ext_mem {
	reg = <0x0 0x86300000 0x0 0x0500000>;
};

&qseecom_mem {
	size = <0 0x1400000>;
};
